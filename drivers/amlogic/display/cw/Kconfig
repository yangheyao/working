## drivers/amlogic/display/cw/Kconfig
```kconfig
#
## Cw Battery configuration
##
menu "Amlogic CW_test Change battery Module"

config AML_CW_TEST
	boolean "CW Change battery Module"
	default n
	help
		CW change battery module

endmenu
```

## drivers/amlogic/display/dlp/Kconfig
```kconfig
#
# Dlp output configuration
#
menu "Amlogic DLP Output Module"

config AML_DLP
	boolean "DLP Output Module"
	default n
	help
		DLP output module

endmenu
```

## drivers/amlogic/display/fan/Kconfig
```kconfig
#
# Fan output configuration
#
menu "Amlogic FAN Output Module"

config AML_FAN
	boolean "FAN Output Module"
	default n
	help
		FAN output module

endmenu
```

## drivers/amlogic/display/hello/Kconfig
```kconfig
#
### Dlp output configuration
###
menu "Amlogic DLP Output Module"

config AML_HELLO
	boolean "HELLO Output Module"
	default n
	help
	HELLO output module

endmenu
```

## drivers/amlogic/input/motor/Kconfig
```kconfig
#
# Input core configuration
#



config AML_MOTOR
	tristate "Amlogic motor device surport"
	default n
	help
	  Say Y here if you want to use the amlogic hold key.
```
